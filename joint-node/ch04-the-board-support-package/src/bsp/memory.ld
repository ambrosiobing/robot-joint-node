/* Generated by tools/gen_memmap.py. Do not edit.
 *
 * The MEMORY block only. The SECTIONS block is in stm32h7a3.ld, which
 * includes this file, because where the regions are is a fact about the
 * part and what goes in them is a decision about the image.
 *
 * A region declared larger than the part has links, reports its size,
 * and overruns at run time. One declared smaller links too and wastes
 * the rest. Neither is a build error, which is why these numbers are
 * generated from doc/memory-map.md's own data rather than typed.
 */
MEMORY
{
    FLASH   (rwx) : ORIGIN = 0x08000000, LENGTH = 2048K
    DTCM    (rwx) : ORIGIN = 0x20000000, LENGTH = 128K
    AXISRAM (rwx) : ORIGIN = 0x24000000, LENGTH = 256K
}

/* The boot address, as a LINKER symbol rather than a C macro, because
 * the script is what has to assert the vector table lands on it and a
 * script cannot read a header. The core fetches the initial stack
 * pointer from here and the reset vector from the four bytes after.
 */
_boot_address = 0x08000000;

/* Recorded in doc/memory-map.md and deliberately NOT declared above:
 *   ITCM at 0x00000000, 64K, instruction tightly coupled memory, and the boot alias lives here too
 *   AXISRAM2 at 0x24040000, 384K, contiguous with AXISRAM, and NOT USED: see the open question
 *   AXISRAM3 at 0x240A0000, 384K, contiguous with AXISRAM2, and NOT USED: see the open question
 *   SRAM_D2A at 0x30000000, 64K, a different domain, so it has its own clock enable
 *   SRAM_D2B at 0x30010000, 64K, contiguous with SRAM_D2A, same domain
 *   SRAM_D3 at 0x38000000, 32K, the always-on domain, which is what makes it useful for a fault record
 */
